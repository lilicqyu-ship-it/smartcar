## smartcar_remote/main/Kconfig.projbuild
```kconfig
menu "smartcar_remote"

    config SCR_BENCH_DISP_ONLY
        bool "BENCH ONLY: display bring-up mode (no Wi-Fi / control tasks)"
        default n
        help
            Diagnostic build to isolate screen jitter: boots the LCD/touch/LVGL
            stack and the UI without starting the radio or control tasks.
            If the screen is STILL unstable here, the cause is hardware
            (power supply / panel timing), not software load.

    config SCR_AP_SSID
        string "C6 softAP SSID (default until NVS holds one)"
        default "SD-DEV000"
        help
            Bench default from esp32c6_car CONFIG_C6_FACTORY_DEV_OVERRIDE.
            Production remotes pair with the real SSID printed on the car.

    config SCR_AP_PASS
        string "C6 softAP password (default until NVS holds one)"
        default "sddev123456"

    config SCR_C6_IP
        string "C6 gateway IPv4"
        default "192.168.4.1"

    config SCR_CTRL_RATE_HZ
        int "DRIVE frame rate in Hz (doubles as the TC275 heartbeat)"
        default 30
        range 5 100

    config SCR_TELE_TIMEOUT_MS
        int "Telemetry stale threshold in ms"
        default 600
        range 100 5000
        help
            50 Hz nominal chain; after this without a frame the UI shows "--"
            instead of stale live data (spec 101).

    config SCR_ALERT_DEBOUNCE_MS
        int "Sustained radio loss before the full-screen alert, in ms"
        default 1200
        range 300 10000
        help
            Telemetry hiccups shorter than this keep the alert suppressed
            (status bar still reacts immediately) so the overlay cannot
            strobe on/off - a full-screen repaint storm shows as severe
            flicker on the RGB panel.

    config SCR_RX_WATCHDOG_MS
        int "WebSocket silence before forced reconnect in ms"
        default 10000
        range 2000 60000

    config SCR_RSSI_EXCELLENT
        int "RSSI >= this dBm counts EXCELLENT"
        default -60
    config SCR_RSSI_GOOD
        int "RSSI >= this dBm counts GOOD"
        default -67
    config SCR_RSSI_FAIR
        int "RSSI >= this dBm counts FAIR"
        default -75
    config SCR_RSSI_WEAK
        int "RSSI >= this dBm counts WEAK, below is CRITICAL"
        default -85
        help
            Spec 26: thresholds are bench defaults and MUST be re-validated by
            real distance tests (10/50/100/200/500 m) before production.

    config SCR_EMERG_LONGPRESS_MS
        int "STOP long-press duration that triggers EMERGENCY, in ms"
        default 1200
        range 500 5000

    config SCR_MODE_ECO_PCT
        int "ECO mode output scale, percent"
        default 50
        range 10 100
    config SCR_MODE_NORMAL_PCT
        int "NORMAL mode output scale, percent"
        default 80
        range 10 100
    config SCR_MODE_SPORT_PCT
        int "SPORT mode output scale, percent"
        default 100
        range 10 100
        help
            Spec 33: client-side limiters only; the real tuning happens on the
            vehicle during test drives.

    config SCR_BATT_LOW_PCT
        int "Vehicle battery low warning, percent"
        default 20
    config SCR_BATT_CRIT_PCT
        int "Vehicle battery critical, percent"
        default 10

    config SCR_OTA_NO_AUTH
        bool "Push OTA to the C6 without a pair token (bench/dev)"
        default y
        help
            Twin of the C6's CONFIG_C6_OTA_NO_AUTH. When y, the FIRMWARE page
            pushes staged images even when the remote is not paired; the
            X-Session-Token header is sent only if a token exists. Images are
            still ed25519-verified on-target. Production MUST set n together
            with C6_OTA_NO_AUTH=n.

    menu "Camera / Vision (S3-gateway / S3-CAM plane, off = C6-only remote)"

        config SCR_S3GW_ENABLE
            bool "S3-gateway video/vision plane (CAMERA + VISION)"
            default n
            help
                Master switch for EVERY remote feature that talks to the
                S3-gateway (S3-CAM board): the /ws/camera video plane
                (scr_cam), the CAMERA + VISION pages, and the {"t":"vision"} /
                {"t":"drive_mode"} text handled on the control plane (produced
                by the S3-gateway's vision component and relayed by the C6).
                The remote's primary link is the C6 - control, telemetry,
                pairing, OTA and diagnostics all live there and stay fully
                functional with this off.  Enable only when a camera-equipped
                S3-gateway is part of the vehicle.

        if SCR_S3GW_ENABLE

        config SCR_CAM_WS_ENABLE
            bool "Camera WS client (/ws/camera preview plane)"
            default y
            help
                Video-plane switch under SCR_S3GW_ENABLE. Off = the remote
                never touches the video plane; control/telemetry/OTA
                unaffected.

        config SCR_CAM_STREAM_PORT
            int "Camera WS TCP port (gateway stream httpd)"
            default 81
            range 1 65535
            help
                The gateway serves /ws/camera on its OWN httpd instance
                (s3_camera, CONFIG_S3_CAMERA_STREAM_PORT there, default 81),
                not on the control-plane :80 - keep the two in sync.

        choice SCR_CAM_PROFILE
            prompt "Default preview profile"
            default SCR_CAM_PROFILE_REMOTE
            help
                Profile requested on first subscribe; switchable in the UI.
                WEB_PREVIEW (640x480) needs the decode slot budget below to
                cover it and ~2x the PSRAM/airtime.

            config SCR_CAM_PROFILE_REMOTE
                bool "REMOTE_PREVIEW 320x240"
            config SCR_CAM_PROFILE_WEB
                bool "WEB_PREVIEW 640x480"
        endchoice

        config SCR_CAM_MAX_JPEG_BYTES
            int "Max JPEG payload per frame (protocol ceiling)"
            default 65536
            range 8192 131072
            help
                Frames above this are dropped as CAM_RX_LEN_ERR. Keep equal
                to CAM_JPEG_LEN_MAX in contracts/camera/cam_frame.h.

        config SCR_CAM_MAX_FPS
            int "Subscribe rate ceiling (fps)"
            default 10
            range 1 30

        config SCR_CAM_FRAME_TIMEOUT_MS
            int "Frame-level stale threshold (NO SIGNAL overlay)"
            default 2000
            range 500 10000
            help
                Subscribed but no decodable frame for this long -> the page
                shows STALE/NO SIGNAL. The WS connection is kept.

        config SCR_CAM_RX_WATCHDOG_MS
            int "Camera WS silence before reconnect"
            default 10000
            range 3000 60000
            help
                Mirrors CONFIG_SCR_RX_WATCHDOG_MS on the video plane; a
                Camera WS restart NEVER touches the control plane.

        config SCR_CAM_SLOTS
            int "Latest-frame slot ring size"
            default 3
            range 2 4
            help
                >= 3 so the LVGL-displayed slot is never written into while
                the decoder targets a second slot (doc: 3-slot ring).

        config SCR_CAM_JPEG_SIMD
            bool "ESP32-S3 SIMD JPEG (esp_new_jpeg), TJpgDec fallback"
            default y
            help
            ESP32-S3 has no JPEG decode peripheral (that IP is on P4/S31;
            driver/jpeg_decode.h / SOC_JPEG_DECODE_SUPPORTED must never be
            used on this target — the symbol is dead here).  Primary decode
            uses espressif/esp_new_jpeg with S3 PIE SIMD and 16-byte-aligned
            RGB565_LE buffers.  A bad frame falls back to esp_jpeg/TJpgDec;
            three consecutive SIMD errors disable it until the next cam_hello.
            Off = TJpgDec only.

        config SCR_CAM_OVERLAY
            bool "Draw vision overlay on the VISION page video"
            default y

        config SCR_VISION_STALE_MS
            int "Vision result stale threshold"
            default 1000
            range 200 5000
            help
                {"t":"vision"} older than this -> STALE, ASSIST falls back
                to MANUAL on screen (S3CAM LLDD 13.4 / Table 21 row 4).

        endif

    endmenu

    menu "Auto power-off (inactivity deep sleep)"

        config SCR_AUTO_OFF_ENABLE
            bool "Auto power-off after touch inactivity (deep sleep)"
            default y
            help
                No touch for SCR_AUTO_OFF_IDLE_MIN minutes -> full-screen
                countdown for SCR_AUTO_OFF_WARN_S seconds; any touch cancels
                and restarts the idle clock; at zero the remote latches a
                vehicle STOP, kills the backlight and enters deep sleep.  This
                board has no soft power latch and no touch INT line, so the
                wake source is the BOOT button (GPIO0, ext0 low level) and a
                deep-sleep wake reboots through the normal boot path.  The
                watchdog also pauses while a C6/TC275 OTA transfer runs.

        config SCR_AUTO_OFF_IDLE_MIN
            int "Touch inactivity before auto power-off, minutes"
            default 5
            range 1 120

        config SCR_AUTO_OFF_WARN_S
            int "Pre-off warning countdown, seconds"
            default 15
            range 5 60
            help
                Must stay well below the idle timeout: the countdown begins
                at (timeout - warn).

    endmenu

endmenu
```
