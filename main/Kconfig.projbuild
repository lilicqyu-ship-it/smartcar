## main/Kconfig.projbuild
```kconfig
menu "smartcar_remote"

    config SCR_BENCH_DISP_ONLY
        bool "BENCH ONLY: display bring-up mode (no Wi-Fi / control tasks)"
        default n
        help
            Diagnostic build to isolate screen jitter: boots the LCD/touch/LVGL
            stack and the UI without starting the radio or control tasks.
            If the screen is STILL unstable here, the cause is hardware
            (power supply / panel timing), not software load.

    config SCR_AP_SSID
        string "C6 softAP SSID (default until NVS holds one)"
        default "SD-DEV000"
        help
            Bench default from esp32c6_car CONFIG_C6_FACTORY_DEV_OVERRIDE.
            Production remotes pair with the real SSID printed on the car.

    config SCR_AP_PASS
        string "C6 softAP password (default until NVS holds one)"
        default "sddev123456"

    config SCR_C6_IP
        string "C6 gateway IPv4"
        default "192.168.4.1"

    config SCR_CTRL_RATE_HZ
        int "DRIVE frame rate in Hz (doubles as the TC275 heartbeat)"
        default 30
        range 5 100

    config SCR_TELE_TIMEOUT_MS
        int "Telemetry stale threshold in ms"
        default 600
        range 100 5000
        help
            50 Hz nominal chain; after this without a frame the UI shows "--"
            instead of stale live data (spec 101).

    config SCR_ALERT_DEBOUNCE_MS
        int "Sustained radio loss before the full-screen alert, in ms"
        default 1200
        range 300 10000
        help
            Telemetry hiccups shorter than this keep the alert suppressed
            (status bar still reacts immediately) so the overlay cannot
            strobe on/off - a full-screen repaint storm shows as severe
            flicker on the RGB panel.

    config SCR_RX_WATCHDOG_MS
        int "WebSocket silence before forced reconnect in ms"
        default 10000
        range 2000 60000

    config SCR_RSSI_EXCELLENT
        int "RSSI >= this dBm counts EXCELLENT"
        default -60
    config SCR_RSSI_GOOD
        int "RSSI >= this dBm counts GOOD"
        default -67
    config SCR_RSSI_FAIR
        int "RSSI >= this dBm counts FAIR"
        default -75
    config SCR_RSSI_WEAK
        int "RSSI >= this dBm counts WEAK, below is CRITICAL"
        default -85
        help
            Spec 26: thresholds are bench defaults and MUST be re-validated by
            real distance tests (10/50/100/200/500 m) before production.

    config SCR_EMERG_LONGPRESS_MS
        int "STOP long-press duration that triggers EMERGENCY, in ms"
        default 1200
        range 500 5000

    config SCR_MODE_ECO_PCT
        int "ECO mode output scale, percent"
        default 50
        range 10 100
    config SCR_MODE_NORMAL_PCT
        int "NORMAL mode output scale, percent"
        default 80
        range 10 100
    config SCR_MODE_SPORT_PCT
        int "SPORT mode output scale, percent"
        default 100
        range 10 100
        help
            Spec 33: client-side limiters only; the real tuning happens on the
            vehicle during test drives.

    config SCR_BATT_LOW_PCT
        int "Vehicle battery low warning, percent"
        default 20
    config SCR_BATT_CRIT_PCT
        int "Vehicle battery critical, percent"
        default 10

    config SCR_OTA_NO_AUTH
        bool "Push OTA to the C6 without a pair token (bench/dev)"
        default y
        help
            Twin of the C6's CONFIG_C6_OTA_NO_AUTH. When y, the FIRMWARE page
            pushes staged images even when the remote is not paired; the
            X-Session-Token header is sent only if a token exists. Images are
            still ed25519-verified on-target. Production MUST set n together
            with C6_OTA_NO_AUTH=n.

endmenu
```

## s3-gateway/components/s3_camera/Kconfig
```kconfig
menu "s3_camera (OV5640 capture + MJPEG stream)"

    config S3_CAMERA_STREAM_PORT
        int "Stream server TCP port"
        default 81
        range 1 65535
        help
            The control page (assets, port 80) embeds
            http://<same-host>:81/stream as an <img>.

    choice S3_CAMERA_FRAME_SIZE_ID
        prompt "Streamed frame size"
        default S3_CAMERA_FRAME_SIZE_VGA
        help
            Larger frames cost bandwidth and PSRAM; the OV5640 sensor does the
            downsampling, so this also sets the JPEG encode load.

        config S3_CAMERA_FRAME_SIZE_QVGA
            bool "320x240 (lowest latency)"
        config S3_CAMERA_FRAME_SIZE_HVGA
            bool "480x320"
        config S3_CAMERA_FRAME_SIZE_VGA
            bool "640x480"
        config S3_CAMERA_FRAME_SIZE_SVGA
            bool "800x600"
        config S3_CAMERA_FRAME_SIZE_HD
            bool "1280x720"
    endchoice

    config S3_CAMERA_FRAME_SIZE
        int
        default 5 if S3_CAMERA_FRAME_SIZE_QVGA
        default 7 if S3_CAMERA_FRAME_SIZE_HVGA
        default 8 if S3_CAMERA_FRAME_SIZE_VGA
        default 9 if S3_CAMERA_FRAME_SIZE_SVGA
        default 11 if S3_CAMERA_FRAME_SIZE_HD

    config S3_CAMERA_JPEG_QUALITY
        int "JPEG quality (0 best .. 63 worst)"
        default 12
        range 4 40
        help
            OV5640 gainly-style scale: 10..15 looks good at VGA without
            saturating the SoftAP link.

endmenu
```

## s3-gateway/components/s3_led/Kconfig
```kconfig
menu "s3_led (WS2812 status indicator)"

    config S3_LED_ENABLE
        bool "Enable WS2812 status LED patterns"
        default y
        help
            One addressable RGB LED (WS2812) driven by RMT on a single GPIO.
            The app state machine maps transitions onto patterns: boot=white
            slow blink, factory_wait=yellow double-blink, net_start=blue 2 Hz,
            online=green heartbeat (normal operation), net failure=red 4 Hz.

    config S3_LED_GPIO
        int "WS2812 data GPIO"
        default 48
        range 0 48
        help
            Freenove ESP32-S3-WROOM CAM keeps one WS2812 on GPIO48 (spare
            on-board status LED).  GPIO26..32 are SPI flash and GPIO33..37
            octal PSRAM - stay off those; GPIO45/46 are strapping pins.

endmenu
```

## s3-gateway/components/s3_link/Kconfig
```kconfig
menu "S3-CAM LINK (SPI slave to TC275, tc275_car doc 22)"

    config S3_LINK_SPI_SCLK_GPIO
        int "LINK SPI SCLK GPIO (from TC275 P33.11)"
        default 40
        range 0 48
        help
            TC275 is the SPI master.  Signal names are unchanged from the C6
            wiring (X1-3 P33.11 SCLK), it now lands on the S3-CAM free header
            pin GPIO40.

    config S3_LINK_SPI_MOSI_GPIO
        int "LINK SPI MOSI GPIO (from TC275 P33.12)"
        default 39
        range 0 48
        help
            X1-4 P33.12 MTSR -> GPIO39 (master TX / slave RX).

    config S3_LINK_SPI_MISO_GPIO
        int "LINK SPI MISO GPIO (to TC275 P33.13)"
        default 41
        range 0 48
        help
            X1-5 P33.13 MRST <- GPIO41 (slave TX, held inactive between
            half-duplex transactions).

    config S3_LINK_SPI_CS_GPIO
        int "LINK SPI CS GPIO (from TC275 P23.4 SLSO5)"
        default 42
        range 0 48
        help
            X1-12 P23.4 SLSO5 -> GPIO42.

    config S3_LINK_SPI_IRQ_GPIO
        int "LINK data-ready IRQ GPIO (open-drain, to TC275 P23.0)"
        default 2
        range 0 48
        help
            GPIO2 -> X1-8 P23.0 (IOM edge IRQ).  Open-drain; the 10k pull-up
            to 3V3 is external hardware (22 §3.2 - without it the link
            degrades to pure polling).  Chosen because it is the only free
            S3-CAM pin outside the camera bus (4..18), native USB (19/20),
            flash (26..32) and octal PSRAM (33..37).

    config S3_LINK_SPI_CLOCK_HZ
        int "Production clock step (master-driven, diag mirror)"
        default 5000000
        range 1000000 20000000
        help
            The master owns the clock; this value is what the slave reports
            in diagnostics and what the TC275 side should be configured to.
            Ladder per 22 §8 G5: 1/2/5/10/20 MHz, production baseline 5 MHz.

    config S3_LINK_DEBUG_UART_RX_GPIO
        int "Debug console RX GPIO (documentation anchor)"
        default 44
        help
            ESP32-S3 UART0 lives on GPIO44(RX)/GPIO43(TX); the Freenove CAM
            board is normally flashed and monitored over the on-board
            USB-Serial-JTAG (GPIO19/20) instead, so these pins are only
            documentation anchors - the LINK uses no UART at all (T3).

    config S3_LINK_DEBUG_UART_TX_GPIO
        int "Debug console TX GPIO (documentation anchor)"
        default 43

endmenu
```
